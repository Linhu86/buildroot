## package/hello/Config.in
```kconfig
config BR2_PACKAGE_HELLO
	bool "hello"
	depends on BR2_PACKAGE_LTTNG_LIBUST
	help
	  lttng hello example.
```

## package/lib320u/Config.in
```kconfig
config BR2_PACKAGE_LIB320U
	bool "lib320u"
	help
	  sierra wireless aircard 320 library.
```

## package/ublxafserver/Config.in
```kconfig
config BR2_PACKAGE_UBLXAFSERVER
	bool "ublxafserver"
	depends on BR2_PACKAGE_LIB320U
	depends on BR2_PACKAGE_UBUS
	help
	  ublx af server application.
```

## package/ublxaftest/Config.in
```kconfig
config BR2_PACKAGE_UBLXAFTEST
	bool "ublxaftest"
	depends on BR2_PACKAGE_UBUS
	help
	  ublx af test application
```

## package/ublxatcmdtest/Config.in
```kconfig
config BR2_PACKAGE_UBLXATCMDTEST
	bool "ublxatcmdtest"
	select BR2_PACKAGE_LIB320U
	help
	  sierra wireless aircard 320 test application.
```

## package/ublxatserver/Config.in
```kconfig
config BR2_PACKAGE_UBLXATSERVER
	bool "ublxatserver"
	depends on BR2_PACKAGE_LIB320U
	depends on BR2_PACKAGE_UBUS
	help
	  ublx at server application.
```

## package/ubus/Config.in
```kconfig
config BR2_PACKAGE_UBUS
	bool "ubus"
	select BR2_PACKAGE_LIBUBOX
	select BR2_PACKAGE_JSON_C
	depends on !BR2_PREFER_STATIC_LIB
	help	
		OpenWrt micro bus architecture, project
		provide communication between various
		daemons and applications.
		http://wiki.openwrt.org/doc/techref/ubus

comment "ubus needs toolchain w/ dynamic library"
	depends on BR2_PREFER_STATIC_LIB 
```
